## boards/shields/aeliux/Kconfig.defconfig
```kconfig
# Copyright (c) 2025 The ZMK Contributors
# SPDX-License-Identifier: MIT

if SHIELD_AELIUX
  
config ZMK_KEYBOARD_NAME
    default "Aeliux"

endif
```

## boards/shields/aeliux_4/Kconfig.defconfig
```kconfig
# Copyright (c) 2025 The ZMK Contributors
# SPDX-License-Identifier: MIT

if ZMK_BACKLIGHT

config PWM
    default y

config LED_PWM
    default y

config ZMK_BACKLIGHT_BRT_STEP
    default 20

config ZMK_BACKLIGHT_BRT_START
    default 40

config ZMK_BACKLIGHT_ON_START
    default y

endif # ZMK_BACKLIGHT

if SHIELD_AELIUX_4

config ZMK_KEYBOARD_NAME
    default "Aeliux 4"

endif
```

## boards/shields/aeliux_4/Kconfig.shield
```kconfig
# Copyright (c) 2025 The ZMK Contributors
# SPDX-License-Identifier: MIT

config SHIELD_AELIUX_4
    def_bool $(shields_list_contains,aeliux_4)
```

## boards/shields/aeliux_ble/Kconfig.defconfig
```kconfig
# Copyright (c) 2025 The ZMK Contributors
# SPDX-License-Identifier: MIT

if SHIELD_AELIUX_BLE
  
config ZMK_KEYBOARD_NAME
    default "Aeliux BLE"

endif
```

## boards/shields/settings_reset_aeliux4/Kconfig.defconfig
```kconfig
# Copyright (c) 2020 The ZMK Contributors
# SPDX-License-Identifier: MIT

if SHIELD_SETTINGS_RESET_AELIUX4

config ZMK_KEYBOARD_NAME
	default "SETTINGS RESET AELIUX4"

endif
```
